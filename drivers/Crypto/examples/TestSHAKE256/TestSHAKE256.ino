/*
 * Copyright (C) 2016 Southern Storm Software, Pty Ltd.
 *
 * Permission is hereby granted, free of charge, to any person obtaining a
 * copy of this software and associated documentation files (the "Software"),
 * to deal in the Software without restriction, including without limitation
 * the rights to use, copy, modify, merge, publish, distribute, sublicense,
 * and/or sell copies of the Software, and to permit persons to whom the
 * Software is furnished to do so, subject to the following conditions:
 *
 * The above copyright notice and this permission notice shall be included
 * in all copies or substantial portions of the Software.
 *
 * THE SOFTWARE IS PROVIDED "AS IS", WITHOUT WARRANTY OF ANY KIND, EXPRESS
 * OR IMPLIED, INCLUDING BUT NOT LIMITED TO THE WARRANTIES OF MERCHANTABILITY,
 * FITNESS FOR A PARTICULAR PURPOSE AND NONINFRINGEMENT. IN NO EVENT SHALL THE
 * AUTHORS OR COPYRIGHT HOLDERS BE LIABLE FOR ANY CLAIM, DAMAGES OR OTHER
 * LIABILITY, WHETHER IN AN ACTION OF CONTRACT, TORT OR OTHERWISE, ARISING
 * FROM, OUT OF OR IN CONNECTION WITH THE SOFTWARE OR THE USE OR OTHER
 * DEALINGS IN THE SOFTWARE.
 */

/*
This example runs tests on the SHAKE256 implementation to verify
correct behaviour.
*/

#include <Crypto.h>
#include <SHAKE.h>
#include <string.h>
#if defined(__AVR__)
#include <avr/pgmspace.h>
#else
#define PROGMEM
#define memcpy_P(d, s, l)   memcpy((d), (s), (l))
#endif

#define MAX_HASH_DATA_SIZE  135
#define MAX_SHAKE_OUTPUT    256

struct TestHashVectorSHAKE {
	const char *name;
	uint8_t data[MAX_HASH_DATA_SIZE];
	size_t dataLen;
	uint8_t hash[MAX_SHAKE_OUTPUT];
};

// Some test vectors from https://github.com/gvanas/KeccakCodePackage
static TestHashVectorSHAKE const testVectorSHAKE256_1 PROGMEM = {
	"SHAKE256 #1",
	{0},
	0,
	{
		0x46, 0xB9, 0xDD, 0x2B, 0x0B, 0xA8, 0x8D, 0x13,
		0x23, 0x3B, 0x3F, 0xEB, 0x74, 0x3E, 0xEB, 0x24,
		0x3F, 0xCD, 0x52, 0xEA, 0x62, 0xB8, 0x1B, 0x82,
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		0x48, 0xD3, 0x39, 0xED, 0xE7, 0x85, 0xFB, 0x7F
	}
};
static TestHashVectorSHAKE const testVectorSHAKE256_2 PROGMEM = {
	"SHAKE256 #2",
	{0x1F, 0x87, 0x7C},
	3,
	{
		0xF6, 0xBF, 0x03, 0x97, 0xDB, 0xFB, 0xB2, 0x0E,
		0x4A, 0xE3, 0x0F, 0x0A, 0x47, 0xFE, 0x97, 0x6C,
		0xD1, 0x09, 0xB3, 0xAA, 0x09, 0xB0, 0xE3, 0xF2,
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		0x5C, 0x43, 0x63, 0x0F, 0x1B, 0xD0, 0x6E, 0x2B
	}
};
static TestHashVectorSHAKE const testVectorSHAKE256_3 PROGMEM = {
	"SHAKE256 #3",
	{
		0xB7, 0x71, 0xD5, 0xCE, 0xF5, 0xD1, 0xA4, 0x1A,
		0x93, 0xD1, 0x56, 0x43, 0xD7, 0x18, 0x1D, 0x2A,
		0x2E, 0xF0, 0xA8, 0xE8, 0x4D, 0x91, 0x81, 0x2F,
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		0xB0, 0xFE, 0xD6, 0xA8, 0x05, 0x2F, 0xBB
	},
	135,
	{
		0x6C, 0x60, 0x95, 0x5D, 0xCB, 0x8A, 0x66, 0x3B,
		0x6D, 0xC7, 0xF5, 0xEF, 0x7E, 0x06, 0x9C, 0xA8,
		0xFE, 0x3D, 0xA9, 0x9A, 0x66, 0xDF, 0x65, 0x96,
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		0xB5, 0x05, 0x07, 0x86, 0x2A, 0xFA, 0x77, 0x99
	}
};

SHAKE256 shake256;
TestHashVectorSHAKE tst;
uint8_t output[MAX_SHAKE_OUTPUT];

bool testSHAKE_N(SHAKE *shake, const struct TestHashVectorSHAKE *test, size_t inc,
                 bool printName = false)
{
	size_t size;
	size_t posn, len;

	// Copy the test case out of program memory.
	memcpy_P(&tst, test, sizeof(tst));
	test = &tst;

	// Print the test name if necessary.
	if (printName) {
		Serial.print(test->name);
		Serial.print(" ... ");
	}

	// Hash the input data.
	if (!inc) {
		inc = 1;
	}
	size = test->dataLen;
	shake->reset();
	for (posn = 0; posn < size; posn += inc) {
		len = size - posn;
		if (len > inc) {
			len = inc;
		}
		shake->update(test->data + posn, len);
	}

	// Generate data using extend() and check it.
	size = MAX_SHAKE_OUTPUT;
	for (posn = 0; posn < size; posn += inc) {
		len = size - posn;
		if (len > inc) {
			len = inc;
		}
		shake->extend(output + posn, len);
	}
	if (memcmp(output, test->hash, size) != 0) {
		return false;
	}

	// Restart and use encrypt() this time.
	shake->reset();
	shake->update(test->data, test->dataLen);
	for (posn = 0; posn < size; ++posn) {
		output[posn] = (uint8_t)(posn + 0xAA);
	}
	for (posn = 0; posn < size; posn += inc) {
		len = size - posn;
		if (len > inc) {
			len = inc;
		}
		shake->encrypt(output + posn, output + posn, len);
	}
	for (posn = 0; posn < size; ++posn) {
		output[posn] ^= (uint8_t)(posn + 0xAA);
	}
	if (memcmp(output, test->hash, size) != 0) {
		return false;
	}

	return true;
}

void testSHAKE(SHAKE *shake, const struct TestHashVectorSHAKE *test)
{
	bool ok;
	size_t dataLen;

	memcpy_P(&dataLen, &(test->dataLen), sizeof(size_t));

	ok  = testSHAKE_N(shake, test, dataLen, true);
	ok &= testSHAKE_N(shake, test, 1);
	ok &= testSHAKE_N(shake, test, 2);
	ok &= testSHAKE_N(shake, test, 5);
	ok &= testSHAKE_N(shake, test, 8);
	ok &= testSHAKE_N(shake, test, 13);
	ok &= testSHAKE_N(shake, test, 16);
	ok &= testSHAKE_N(shake, test, 24);
	ok &= testSHAKE_N(shake, test, 63);
	ok &= testSHAKE_N(shake, test, 64);

	if (ok) {
		Serial.println("Passed");
	} else {
		Serial.println("Failed");
	}
}

void perfUpdate(SHAKE *shake)
{
	unsigned long start;
	unsigned long elapsed;
	int count;

	Serial.print("Updating ... ");

	for (size_t posn = 0; posn < MAX_SHAKE_OUTPUT; ++posn) {
		output[posn] = (uint8_t)posn;
	}

	shake->reset();
	start = micros();
	for (count = 0; count < 300; ++count) {
		shake->update(output, MAX_SHAKE_OUTPUT);
	}
	shake->extend(output, 0);   // Force a finalize after the update.
	elapsed = micros() - start;

	Serial.print(elapsed / (MAX_SHAKE_OUTPUT * 300.0));
	Serial.print("us per byte, ");
	Serial.print((MAX_SHAKE_OUTPUT * 300.0 * 1000000.0) / elapsed);
	Serial.println(" bytes per second");
}

void perfExtend(SHAKE *shake)
{
	unsigned long start;
	unsigned long elapsed;
	int count;

	Serial.print("Extending ... ");

	for (size_t posn = 0; posn < MAX_SHAKE_OUTPUT; ++posn) {
		output[posn] = (uint8_t)posn;
	}

	shake->reset();
	shake->update(output, MAX_SHAKE_OUTPUT);
	shake->extend(output, 0);   // Force a finalize after the update.
	start = micros();
	for (count = 0; count < 300; ++count) {
		shake->extend(output, MAX_SHAKE_OUTPUT);
	}
	elapsed = micros() - start;

	Serial.print(elapsed / (MAX_SHAKE_OUTPUT * 300.0));
	Serial.print("us per byte, ");
	Serial.print((MAX_SHAKE_OUTPUT * 300.0 * 1000000.0) / elapsed);
	Serial.println(" bytes per second");
}

void perfEncrypt(SHAKE *shake)
{
	unsigned long start;
	unsigned long elapsed;
	int count;

	Serial.print("Encrypting ... ");

	for (size_t posn = 0; posn < MAX_SHAKE_OUTPUT; ++posn) {
		output[posn] = (uint8_t)posn;
	}

	shake->reset();
	shake->update(output, MAX_SHAKE_OUTPUT);
	shake->extend(output, 0);   // Force a finalize after the update.
	start = micros();
	for (count = 0; count < 300; ++count) {
		shake->encrypt(output, output, MAX_SHAKE_OUTPUT);
	}
	elapsed = micros() - start;

	Serial.print(elapsed / (MAX_SHAKE_OUTPUT * 300.0));
	Serial.print("us per byte, ");
	Serial.print((MAX_SHAKE_OUTPUT * 300.0 * 1000000.0) / elapsed);
	Serial.println(" bytes per second");
}

void setup()
{
	Serial.begin(9600);

	Serial.println();

	Serial.print("State Size ...");
	Serial.println(sizeof(SHAKE256));
	Serial.println();

	Serial.println("Test Vectors:");
	testSHAKE(&shake256, &testVectorSHAKE256_1);
	testSHAKE(&shake256, &testVectorSHAKE256_2);
	testSHAKE(&shake256, &testVectorSHAKE256_3);

	Serial.println();

	Serial.println("Performance Tests:");
	perfUpdate(&shake256);
	perfExtend(&shake256);
	perfEncrypt(&shake256);
}

void loop()
{
}
