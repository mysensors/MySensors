/*
 * Copyright (C) 2016 Southern Storm Software, Pty Ltd.
 *
 * Permission is hereby granted, free of charge, to any person obtaining a
 * copy of this software and associated documentation files (the "Software"),
 * to deal in the Software without restriction, including without limitation
 * the rights to use, copy, modify, merge, publish, distribute, sublicense,
 * and/or sell copies of the Software, and to permit persons to whom the
 * Software is furnished to do so, subject to the following conditions:
 *
 * The above copyright notice and this permission notice shall be included
 * in all copies or substantial portions of the Software.
 *
 * THE SOFTWARE IS PROVIDED "AS IS", WITHOUT WARRANTY OF ANY KIND, EXPRESS
 * OR IMPLIED, INCLUDING BUT NOT LIMITED TO THE WARRANTIES OF MERCHANTABILITY,
 * FITNESS FOR A PARTICULAR PURPOSE AND NONINFRINGEMENT. IN NO EVENT SHALL THE
 * AUTHORS OR COPYRIGHT HOLDERS BE LIABLE FOR ANY CLAIM, DAMAGES OR OTHER
 * LIABILITY, WHETHER IN AN ACTION OF CONTRACT, TORT OR OTHERWISE, ARISING
 * FROM, OUT OF OR IN CONNECTION WITH THE SOFTWARE OR THE USE OR OTHER
 * DEALINGS IN THE SOFTWARE.
 */

/*
This example runs tests on the P521 algorithm.

Note: This example is too large to run on the Arduino Uno or other
AVR platforms with 32K or less of flash memory.
*/

#include <Crypto.h>
#include <P521.h>
#include <SHA256.h>
#include <SHA512.h>
#include <RNG.h>
#include <RNG.h>
#include <string.h>
#include <avr/pgmspace.h>

void printNumber(const char *name, const uint8_t *x, size_t len)
{
	static const char hexchars[] = "0123456789ABCDEF";
	Serial.print(name);
	Serial.print(" = ");
	for (size_t posn = 0; posn < len; ++posn) {
		Serial.print(hexchars[(x[posn] >> 4) & 0x0F]);
		Serial.print(hexchars[x[posn] & 0x0F]);
	}
	Serial.println();
}

static int P521_memcmp_P(const void *s1, const void *s2, size_t len)
{
	const uint8_t *u1 = (const uint8_t *)s1;
	const uint8_t *u2 = (const uint8_t *)s2;
	while (len > 0) {
		int ch1 = *u1++;
		int ch2 = pgm_read_byte(u2++);
		if (ch1 != ch2) {
			return ch1 - ch2;
		}
		--len;
	}
	return 0;
}

static uint8_t alice_k[132];
static uint8_t alice_f[66];
static uint8_t bob_k[132];
static uint8_t bob_f[66];

// Check the eval() function using the test vectors from RFC 5903.
void testEval()
{
	static uint8_t const alice_private[66] PROGMEM = {
		0x00, 0x37, 0xAD, 0xE9, 0x31, 0x9A, 0x89, 0xF4,
		0xDA, 0xBD, 0xB3, 0xEF, 0x41, 0x1A, 0xAC, 0xCC,
		0xA5, 0x12, 0x3C, 0x61, 0xAC, 0xAB, 0x57, 0xB5,
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		0x4A, 0x52
	};
	static uint8_t const alice_public[132] PROGMEM = {
		0x00, 0x15, 0x41, 0x7E, 0x84, 0xDB, 0xF2, 0x8C,
		0x0A, 0xD3, 0xC2, 0x78, 0x71, 0x33, 0x49, 0xDC,
		0x7D, 0xF1, 0x53, 0xC8, 0x97, 0xA1, 0x89, 0x1B,
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		0x92, 0x6F, 0x95, 0x82
	};
	static uint8_t const bob_private[66] PROGMEM = {
		0x01, 0x45, 0xBA, 0x99, 0xA8, 0x47, 0xAF, 0x43,
		0x79, 0x3F, 0xDD, 0x0E, 0x87, 0x2E, 0x7C, 0xDF,
		0xA1, 0x6B, 0xE3, 0x0F, 0xDC, 0x78, 0x0F, 0x97,
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		0x5E, 0xB9
	};
	static uint8_t const bob_public[132] PROGMEM = {
		0x00, 0xD0, 0xB3, 0x97, 0x5A, 0xC4, 0xB7, 0x99,
		0xF5, 0xBE, 0xA1, 0x6D, 0x5E, 0x13, 0xE9, 0xAF,
		0x97, 0x1D, 0x5E, 0x9B, 0x98, 0x4C, 0x9F, 0x39,
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		0x7F, 0x0F, 0xC5, 0x6A
	};
	static uint8_t const shared_secret[66] PROGMEM = {
		0x01, 0x14, 0x4C, 0x7D, 0x79, 0xAE, 0x69, 0x56,
		0xBC, 0x8E, 0xDB, 0x8E, 0x7C, 0x78, 0x7C, 0x45,
		0x21, 0xCB, 0x08, 0x6F, 0xA6, 0x44, 0x07, 0xF9,
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		0xDD, 0xEA
	};

	// Evaluate the curve function and check the public keys.
	uint8_t result[132];
	Serial.println("Fixed test vectors:");
	Serial.print("Computing Alice's public key ... ");
	Serial.flush();
	memcpy_P(alice_f, alice_private, 66);
	unsigned long start = micros();
	P521::eval(result, alice_f, 0);
	unsigned long elapsed = micros() - start;
	if (P521_memcmp_P(result, alice_public, 132) == 0) {
		Serial.print("ok");
	} else {
		Serial.println("failed");
		printNumber("actual  ", result, 132);
		printNumber("expected", alice_f, 132);
	}
	Serial.print(" (elapsed ");
	Serial.print(elapsed);
	Serial.println(" us)");
	Serial.print("Computing Bob's public key ... ");
	Serial.flush();
	memcpy_P(bob_f, bob_private, 66);
	start = micros();
	P521::eval(result, bob_f, 0);
	elapsed = micros() - start;
	if (P521_memcmp_P(result, bob_public, 132) == 0) {
		Serial.print("ok");
	} else {
		Serial.println("failed");
		printNumber("actual  ", result, 132);
		printNumber("expected", bob_f, 132);
	}
	Serial.print(" (elapsed ");
	Serial.print(elapsed);
	Serial.println(" us)");

	// Compute the shared secret from each side.
	Serial.print("Computing Alice's shared secret ... ");
	Serial.flush();
	memcpy_P(alice_f, alice_private, 66);
	memcpy_P(bob_k, bob_public, 132);
	memcpy_P(bob_f, shared_secret, 66);
	start = micros();
	P521::eval(result, alice_f, bob_k);
	elapsed = micros() - start;
	if (P521_memcmp_P(result, shared_secret, 66) == 0) {
		Serial.print("ok");
	} else {
		Serial.println("failed");
		printNumber("actual  ", result, 66);
		printNumber("expected", bob_f, 66);
	}
	Serial.print(" (elapsed ");
	Serial.print(elapsed);
	Serial.println(" us)");
	Serial.print("Computing Bob's shared secret ... ");
	Serial.flush();
	memcpy_P(bob_f, bob_private, 66);
	memcpy_P(alice_k, alice_public, 132);
	memcpy_P(alice_f, shared_secret, 66);
	start = micros();
	P521::eval(result, bob_f, alice_k);
	elapsed = micros() - start;
	if (P521_memcmp_P(result, shared_secret, 66) == 0) {
		Serial.print("ok");
	} else {
		Serial.println("failed");
		printNumber("actual  ", result, 66);
		printNumber("expected", alice_f, 66);
	}
	Serial.print(" (elapsed ");
	Serial.print(elapsed);
	Serial.println(" us)");
}

void testDH()
{
	Serial.println("Diffie-Hellman key exchange:");
	Serial.print("Generate random k/f for Alice ... ");
	Serial.flush();
	unsigned long start = micros();
	P521::dh1(alice_k, alice_f);
	unsigned long elapsed = micros() - start;
	Serial.print("elapsed ");
	Serial.print(elapsed);
	Serial.println(" us");

	Serial.print("Generate random k/f for Bob ... ");
	Serial.flush();
	start = micros();
	P521::dh1(bob_k, bob_f);
	elapsed = micros() - start;
	Serial.print("elapsed ");
	Serial.print(elapsed);
	Serial.println(" us");

	Serial.print("Generate shared secret for Alice ... ");
	Serial.flush();
	start = micros();
	P521::dh2(bob_k, alice_f);
	elapsed = micros() - start;
	Serial.print("elapsed ");
	Serial.print(elapsed);
	Serial.println(" us");

	Serial.print("Generate shared secret for Bob ... ");
	Serial.flush();
	start = micros();
	P521::dh2(alice_k, bob_f);
	elapsed = micros() - start;
	Serial.print("elapsed ");
	Serial.print(elapsed);
	Serial.println(" us");

	Serial.print("Check that the shared secrets match ... ");
	if (memcmp(alice_f, bob_f, 66) == 0) {
		Serial.println("ok");
	} else {
		Serial.println("failed");
		printNumber("actual  ", alice_f, 66);
		printNumber("expected", bob_f, 66);
	}
}

struct TestSignKey {
	uint8_t privateKey[66];
	uint8_t publicKey[132];
};

// Test key from RFC 6979, Appendix A.2.7.
static TestSignKey const testKeyP521 PROGMEM = {
	{
		0x00, 0xFA, 0xD0, 0x6D, 0xAA, 0x62, 0xBA, 0x3B,        // x
		0x25, 0xD2, 0xFB, 0x40, 0x13, 0x3D, 0xA7, 0x57,
		0x20, 0x5D, 0xE6, 0x7F, 0x5B, 0xB0, 0x01, 0x8F,
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		0x35, 0x38
	},
	{
		0x01, 0x89, 0x45, 0x50, 0xD0, 0x78, 0x59, 0x32,        // Ux
		0xE0, 0x0E, 0xAA, 0x23, 0xB6, 0x94, 0xF2, 0x13,
		0xF8, 0xC3, 0x12, 0x1F, 0x86, 0xDC, 0x97, 0xA0,
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		0xFC, 0xF5
	}
};

struct TestSignVector {
	const char *name;
	const char *data;
	uint8_t signature[132];
};

// Test vectors from RFC 6979, Appendix A.2.7.
static TestSignVector const testVectorP521_1 PROGMEM = {
	// P-521 test case with SHA-256 and message "sample".
	"P-521 #1",
	"sample",
	{
		0x01, 0x51, 0x1B, 0xB4, 0xD6, 0x75, 0x11, 0x4F,        // r
		0xE2, 0x66, 0xFC, 0x43, 0x72, 0xB8, 0x76, 0x82,
		0xBA, 0xEC, 0xC0, 0x1D, 0x3C, 0xC6, 0x2C, 0xF2,
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		0xEC, 0xFC
	}
};
static TestSignVector const testVectorP521_2 PROGMEM = {
	// P-521 test case with SHA-512 and message "sample".
	"P-521 #2",
	"sample",
	{
		0x00, 0xC3, 0x28, 0xFA, 0xFC, 0xBD, 0x79, 0xDD,        // r
		0x77, 0x85, 0x03, 0x70, 0xC4, 0x63, 0x25, 0xD9,
		0x87, 0xCB, 0x52, 0x55, 0x69, 0xFB, 0x63, 0xC5,
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		0xA6, 0x7A
	}
};
static TestSignVector const testVectorP521_3 PROGMEM = {
	// P-521 test case with SHA-256 and message "test".
	"P-521 #3",
	"test",
	{
		0x00, 0x0E, 0x87, 0x1C, 0x4A, 0x14, 0xF9, 0x93,        // r
		0xC6, 0xC7, 0x36, 0x95, 0x01, 0x90, 0x0C, 0x4B,
		0xC1, 0xE9, 0xC7, 0xB0, 0xB4, 0xBA, 0x44, 0xE0,
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		0x4E, 0x86
	}
};
static TestSignVector const testVectorP521_4 PROGMEM = {
	// P-521 test case with SHA-512 and message "test".
	"P-521 #4",
	"test",
	{
		0x01, 0x3E, 0x99, 0x02, 0x0A, 0xBF, 0x5C, 0xEE,        // r
		0x75, 0x25, 0xD1, 0x6B, 0x69, 0xB2, 0x29, 0x65,
		0x2A, 0xB6, 0xBD, 0xF2, 0xAF, 0xFC, 0xAE, 0xF3,
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		0xDC, 0xE3
	}
};

void testSignCommon(const struct TestSignVector *_test, Hash *hash)
{
	uint8_t *privateKey = alice_f;
	uint8_t *publicKey = alice_k;
	uint8_t *sig = bob_k;
	static TestSignVector test;

	memcpy_P(&test, _test, sizeof(test));

	Serial.print(test.name);
	Serial.print(" Sign ... ");
	Serial.flush();

	memcpy_P(privateKey, testKeyP521.privateKey, 66);

	unsigned long start = micros();
	P521::sign(sig, privateKey, test.data, strlen(test.data), hash);
	unsigned long elapsed = micros() - start;
	Serial.print(elapsed);
	Serial.print(" us ... ");

	bool ok = !memcmp(sig, test.signature, 132);
	if (ok) {
		Serial.println("ok");
	} else {
		Serial.println("failed");
		printNumber("actual  ", sig, 132);
		printNumber("expected", test.signature, 132);
	}

	Serial.print(test.name);
	Serial.print(" Verify ... ");
	Serial.flush();

	memcpy_P(publicKey, testKeyP521.publicKey, 132);

	start = micros();
	bool verified = P521::verify
	                (test.signature, publicKey, test.data, strlen(test.data), hash);
	elapsed = micros() - start;
	Serial.print(elapsed);
	Serial.print(" us ... ");

	if (verified) {
		Serial.println("ok");
	} else {
		Serial.println("failed");
	}

	Serial.print(test.name);
	Serial.print(" Derive Public Key ... ");
	Serial.flush();

	memcpy_P(privateKey, testKeyP521.privateKey, 66);

	start = micros();
	P521::derivePublicKey(publicKey, privateKey);
	elapsed = micros() - start;
	Serial.print(elapsed);
	Serial.print(" us ... ");

	ok = !P521_memcmp_P(publicKey, testKeyP521.publicKey, 132);
	if (ok) {
		Serial.println("ok");
	} else {
		Serial.println("failed");
		printNumber("actual  ", publicKey, 132);
		memcpy_P(publicKey, testKeyP521.publicKey, 132);
		printNumber("expected", publicKey, 132);
	}
}

void testSignSHA256(const struct TestSignVector *test)
{
	SHA256 hash;
	testSignCommon(test, &hash);
}

void testSignSHA512(const struct TestSignVector *test)
{
	SHA512 hash;
	testSignCommon(test, &hash);
}

void testSign()
{
	Serial.println("Digital signatures:");
	testSignSHA256(&testVectorP521_1);
	testSignSHA512(&testVectorP521_2);
	testSignSHA256(&testVectorP521_3);
	testSignSHA512(&testVectorP521_4);
}

void setup()
{
	Serial.begin(9600);

	// Start the random number generator.  We don't initialise a noise
	// source here because we don't need one for testing purposes.
	// Real DH applications should of course use a proper noise source.
	RNG.begin("TestP521 1.0", 950);

	// Perform the tests.
	testEval();
	Serial.println();
	testDH();
	Serial.println();
	testSign();
	Serial.println();
}

void loop()
{
}
