/*
 * Copyright (C) 2016 Southern Storm Software, Pty Ltd.
 *
 * Permission is hereby granted, free of charge, to any person obtaining a
 * copy of this software and associated documentation files (the "Software"),
 * to deal in the Software without restriction, including without limitation
 * the rights to use, copy, modify, merge, publish, distribute, sublicense,
 * and/or sell copies of the Software, and to permit persons to whom the
 * Software is furnished to do so, subject to the following conditions:
 *
 * The above copyright notice and this permission notice shall be included
 * in all copies or substantial portions of the Software.
 *
 * THE SOFTWARE IS PROVIDED "AS IS", WITHOUT WARRANTY OF ANY KIND, EXPRESS
 * OR IMPLIED, INCLUDING BUT NOT LIMITED TO THE WARRANTIES OF MERCHANTABILITY,
 * FITNESS FOR A PARTICULAR PURPOSE AND NONINFRINGEMENT. IN NO EVENT SHALL THE
 * AUTHORS OR COPYRIGHT HOLDERS BE LIABLE FOR ANY CLAIM, DAMAGES OR OTHER
 * LIABILITY, WHETHER IN AN ACTION OF CONTRACT, TORT OR OTHERWISE, ARISING
 * FROM, OUT OF OR IN CONNECTION WITH THE SOFTWARE OR THE USE OR OTHER
 * DEALINGS IN THE SOFTWARE.
 */

/*
This example runs tests on the SHAKE128 implementation to verify
correct behaviour.
*/

#include <Crypto.h>
#include <SHAKE.h>
#include <string.h>
#if defined(__AVR__)
#include <avr/pgmspace.h>
#else
#define PROGMEM
#define memcpy_P(d, s, l)   memcpy((d), (s), (l))
#endif

#define MAX_HASH_DATA_SIZE  167
#define MAX_SHAKE_OUTPUT    256

struct TestHashVectorSHAKE {
	const char *name;
	uint8_t data[MAX_HASH_DATA_SIZE];
	size_t dataLen;
	uint8_t hash[MAX_SHAKE_OUTPUT];
};

// Some test vectors from https://github.com/gvanas/KeccakCodePackage
static TestHashVectorSHAKE const testVectorSHAKE128_1 PROGMEM = {
	"SHAKE128 #1",
	{0},
	0,
	{
		0x7F, 0x9C, 0x2B, 0xA4, 0xE8, 0x8F, 0x82, 0x7D,
		0x61, 0x60, 0x45, 0x50, 0x76, 0x05, 0x85, 0x3E,
		0xD7, 0x3B, 0x80, 0x93, 0xF6, 0xEF, 0xBC, 0x88,
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		0x61, 0x15, 0xBA, 0xD4, 0x69, 0x2D, 0x86, 0x19
	}
};
static TestHashVectorSHAKE const testVectorSHAKE128_2 PROGMEM = {
	"SHAKE128 #2",
	{0x1F, 0x87, 0x7C},
	3,
	{
		0xE2, 0xD3, 0x14, 0x46, 0x69, 0xAB, 0x57, 0x83,
		0x47, 0xFC, 0xCA, 0x0B, 0x57, 0x27, 0x83, 0xA2,
		0x69, 0xA8, 0xCF, 0x9A, 0xDD, 0xA4, 0xD8, 0x77,
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		0xCD, 0x48, 0xE3, 0x0E, 0x37, 0xFE, 0x5F, 0xD0
	}
};
static TestHashVectorSHAKE const testVectorSHAKE128_3 PROGMEM = {
	"SHAKE128 #3",
	{
		0x0D, 0x8D, 0x09, 0xAE, 0xD1, 0x9F, 0x10, 0x13,
		0x96, 0x9C, 0xE5, 0xE7, 0xEB, 0x92, 0xF8, 0x3A,
		0x20, 0x9A, 0xE7, 0x6B, 0xE3, 0x1C, 0x75, 0x48,
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		0xC6, 0xF4, 0x75, 0x60, 0x17, 0xFF, 0xF5
	},
	167,
	{
		0xC7, 0x3D, 0x8F, 0xAA, 0xB5, 0xD0, 0xB4, 0xD6,
		0x60, 0xBD, 0x50, 0x82, 0xE4, 0x4C, 0x3C, 0xAC,
		0x97, 0xE6, 0x16, 0x48, 0xBE, 0x0A, 0x04, 0xB1,
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		0xB1, 0x1B, 0x71, 0x81, 0xC4, 0x2B, 0xE9, 0xB7
	}
};

SHAKE128 shake128;
TestHashVectorSHAKE tst;
uint8_t output[MAX_SHAKE_OUTPUT];

bool testSHAKE_N(SHAKE *shake, const struct TestHashVectorSHAKE *test, size_t inc,
                 bool printName = false)
{
	size_t size;
	size_t posn, len;

	// Copy the test case out of program memory.
	memcpy_P(&tst, test, sizeof(tst));
	test = &tst;

	// Print the test name if necessary.
	if (printName) {
		Serial.print(test->name);
		Serial.print(" ... ");
	}

	// Hash the input data.
	if (!inc) {
		inc = 1;
	}
	size = test->dataLen;
	shake->reset();
	for (posn = 0; posn < size; posn += inc) {
		len = size - posn;
		if (len > inc) {
			len = inc;
		}
		shake->update(test->data + posn, len);
	}

	// Generate data using extend() and check it.
	size = MAX_SHAKE_OUTPUT;
	for (posn = 0; posn < size; posn += inc) {
		len = size - posn;
		if (len > inc) {
			len = inc;
		}
		shake->extend(output + posn, len);
	}
	if (memcmp(output, test->hash, size) != 0) {
		return false;
	}

	// Restart and use encrypt() this time.
	shake->reset();
	shake->update(test->data, test->dataLen);
	for (posn = 0; posn < size; ++posn) {
		output[posn] = (uint8_t)(posn + 0xAA);
	}
	for (posn = 0; posn < size; posn += inc) {
		len = size - posn;
		if (len > inc) {
			len = inc;
		}
		shake->encrypt(output + posn, output + posn, len);
	}
	for (posn = 0; posn < size; ++posn) {
		output[posn] ^= (uint8_t)(posn + 0xAA);
	}
	if (memcmp(output, test->hash, size) != 0) {
		return false;
	}

	return true;
}

void testSHAKE(SHAKE *shake, const struct TestHashVectorSHAKE *test)
{
	bool ok;
	size_t dataLen;

	memcpy_P(&dataLen, &(test->dataLen), sizeof(size_t));

	ok  = testSHAKE_N(shake, test, dataLen, true);
	ok &= testSHAKE_N(shake, test, 1);
	ok &= testSHAKE_N(shake, test, 2);
	ok &= testSHAKE_N(shake, test, 5);
	ok &= testSHAKE_N(shake, test, 8);
	ok &= testSHAKE_N(shake, test, 13);
	ok &= testSHAKE_N(shake, test, 16);
	ok &= testSHAKE_N(shake, test, 24);
	ok &= testSHAKE_N(shake, test, 63);
	ok &= testSHAKE_N(shake, test, 64);

	if (ok) {
		Serial.println("Passed");
	} else {
		Serial.println("Failed");
	}
}

void perfUpdate(SHAKE *shake)
{
	unsigned long start;
	unsigned long elapsed;
	int count;

	Serial.print("Updating ... ");

	for (size_t posn = 0; posn < MAX_SHAKE_OUTPUT; ++posn) {
		output[posn] = (uint8_t)posn;
	}

	shake->reset();
	start = micros();
	for (count = 0; count < 300; ++count) {
		shake->update(output, MAX_SHAKE_OUTPUT);
	}
	shake->extend(output, 0);   // Force a finalize after the update.
	elapsed = micros() - start;

	Serial.print(elapsed / (MAX_SHAKE_OUTPUT * 300.0));
	Serial.print("us per byte, ");
	Serial.print((MAX_SHAKE_OUTPUT * 300.0 * 1000000.0) / elapsed);
	Serial.println(" bytes per second");
}

void perfExtend(SHAKE *shake)
{
	unsigned long start;
	unsigned long elapsed;
	int count;

	Serial.print("Extending ... ");

	for (size_t posn = 0; posn < MAX_SHAKE_OUTPUT; ++posn) {
		output[posn] = (uint8_t)posn;
	}

	shake->reset();
	shake->update(output, MAX_SHAKE_OUTPUT);
	shake->extend(output, 0);   // Force a finalize after the update.
	start = micros();
	for (count = 0; count < 300; ++count) {
		shake->extend(output, MAX_SHAKE_OUTPUT);
	}
	elapsed = micros() - start;

	Serial.print(elapsed / (MAX_SHAKE_OUTPUT * 300.0));
	Serial.print("us per byte, ");
	Serial.print((MAX_SHAKE_OUTPUT * 300.0 * 1000000.0) / elapsed);
	Serial.println(" bytes per second");
}

void perfEncrypt(SHAKE *shake)
{
	unsigned long start;
	unsigned long elapsed;
	int count;

	Serial.print("Encrypting ... ");

	for (size_t posn = 0; posn < MAX_SHAKE_OUTPUT; ++posn) {
		output[posn] = (uint8_t)posn;
	}

	shake->reset();
	shake->update(output, MAX_SHAKE_OUTPUT);
	shake->extend(output, 0);   // Force a finalize after the update.
	start = micros();
	for (count = 0; count < 300; ++count) {
		shake->encrypt(output, output, MAX_SHAKE_OUTPUT);
	}
	elapsed = micros() - start;

	Serial.print(elapsed / (MAX_SHAKE_OUTPUT * 300.0));
	Serial.print("us per byte, ");
	Serial.print((MAX_SHAKE_OUTPUT * 300.0 * 1000000.0) / elapsed);
	Serial.println(" bytes per second");
}

void setup()
{
	Serial.begin(9600);

	Serial.println();

	Serial.print("State Size ...");
	Serial.println(sizeof(SHAKE128));
	Serial.println();

	Serial.println("Test Vectors:");
	testSHAKE(&shake128, &testVectorSHAKE128_1);
	testSHAKE(&shake128, &testVectorSHAKE128_2);
	testSHAKE(&shake128, &testVectorSHAKE128_3);

	Serial.println();

	Serial.println("Performance Tests:");
	perfUpdate(&shake128);
	perfExtend(&shake128);
	perfEncrypt(&shake128);
}

void loop()
{
}
